## src/arch/Kconfig
```kconfig
source src/arch/riscv/Kconfig

menu "CPU"

choice
	prompt "CPU"
	default CPU_MINERVA

config CPU_MINERVA
	bool "Minerva"
	select CPU_ARCH_RISCV

config CPU_VEXRISCV
	bool "Vexriscv"
	select CPU_ARCH_RISCV

endchoice

config CPU_BYTEORDER_LITTLE
	bool
	default "y" 

config CPU_RESET_ADDR
	hex "Reset vector address"

config CPU_DATA_WIDTH
	int
	default 32

endmenu
```
